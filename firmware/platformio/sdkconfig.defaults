## firmware/platformio/sdkconfig.defaults
```kconfig
# ESP-IDF SDK Configuration for ESP-WiFi-Mesh on Seeed XIAO ESP32-C3
# This file provides default configuration values for PlatformIO to auto-generate sdkconfig

# ============================================================================
# WiFi Configuration
# ============================================================================
CONFIG_ESP_WIFI_SOFTAP_SUPPORT=y
CONFIG_ESP_WIFI_MESH_SUPPORT=y
CONFIG_ESP_WIFI_ESPMAC=y

# ============================================================================
# ESP-WiFi-Mesh Configuration
# ============================================================================
CONFIG_MESH_ESP_WIFI_MESH=y
CONFIG_MESH_MAX_HOPS=10
CONFIG_MESH_MAX_LAYER=10
CONFIG_MESH_VOTE_PERCENT=1
CONFIG_MESH_MAX_TTL=10
CONFIG_MESH_MAX_NEIGHBORS=50
CONFIG_MESH_MAX_KNOWN_PEERS=200
CONFIG_MESH_RSSI_THRESHOLD=-80
CONFIG_MESH_NEIGHBOR_TIMEOUT_MS=5000
CONFIG_MESH_AP_IDLE_INTERVAL_MS=10000
CONFIG_MESH_AP_SCAN_INTERVAL_MS=30000
CONFIG_MESH_AP_MAX_AGE_MS=60000

# ============================================================================
# UDP Configuration
# ============================================================================
CONFIG_MESH_UDP_PORT=1234

# ============================================================================
# TX Power Configuration
# ============================================================================
CONFIG_ESP_WIFI_TX_POWER.Control=y
CONFIG_ESP_WIFI_MAX_TX_POWER=20
CONFIG_ESP_WIFI_MIN_TX_POWER=0

# ============================================================================
# Network Configuration
# ============================================================================
CONFIG_LWIP_IPV4=y
CONFIG_LWIP_DHCP=y

# ============================================================================
# Logging Configuration
# ============================================================================
CONFIG_LOG_DEFAULT_LEVEL_INFO=y
CONFIG_MESH_DEBUG=y

# ============================================================================
# Hardware Configuration for ESP32-C3
# ============================================================================
CONFIG_ESP32_WIFI_SOFTAP_SUPPORT=y
CONFIG_ESP32_WIFI_NVS_ENABLED=y

# ============================================================================
# Memory Configuration
# ============================================================================
CONFIG_SPIRAM_ICACHE=y
CONFIG_SPIRAM_SPIRAM_MODE=y

# ============================================================================
# Component Configuration
# ============================================================================
CONFIG_FREERTOS_UNICORE=y
CONFIG_FREERTOS_USE_TICKLESS_IDLE=y
```

## firmware/sdkconfig.defaults
```kconfig
# Default SDK Configuration for ESP32 Mesh Node
# Adaptive mesh topology with UDP unicast and dynamic TX power

# ============================================================================
# WiFi Configuration
# ============================================================================

CONFIG_ESP_WIFI_SOFTAP_SUPPORT=y
CONFIG_ESP_WIFI_ESPNOW_SUPPORT=y
CONFIG_ESP_WIFI_MESH_SUPPORT=y
CONFIG_ESP_WIFI_SOFTAP_PROMISCUOUS=y
CONFIG_ESP_WIFI_AMPDU_TX_ENABLED=y
CONFIG_ESP_WIFI_AMPDU_RX_ENABLED=y
CONFIG_ESP_WIFI_TX_BA_WIN=16
CONFIG_ESP_WIFI_RX_BA_WIN=16

# ============================================================================
# Mesh Configuration
# ============================================================================

CONFIG_ESP_MESH_ENABLED=y
CONFIG_ESP_MESH_MAX_HOPS=10
CONFIG_ESP_MESH_VOTE_PERCENTAGE=1
CONFIG_ESP_MESH_MAX_LAYER=10
CONFIG_ESP_MESH_MAX_CONNECTIONS=6
CONFIG_ESP_MESH_ASSOCIATION_EXPIRE_TIME_MS=60000
CONFIG_ESP_MESH_CAPABILITY_WIFI_STA=y
CONFIG_ESP_MESH_CAPABILITY_WIFI_AP=y

# ============================================================================
# lwIP Configuration
# ============================================================================

CONFIG_LWIP_DHCP_SERVER=y
CONFIG_LWIP_DNS_SERVER=y
CONFIG_LWIP_IPV4=y
CONFIG_LWIP_IPV6=y
CONFIG_LWIP_TCP=y
CONFIG_LWIP_UDP=y
CONFIG_LWIP_RAW=y
CONFIG_LWIP_SOCKET=y
CONFIG_LWIP_NETIF_API=y
CONFIG_LWIP_DHCP=y
CONFIG_LWIP_AUTOIP=y
CONFIG_LWIP_IGMP=y
CONFIG_LWIP_MULTICAST_TX_OPTIONS=y

# ============================================================================
# System Configuration
# ============================================================================

CONFIG_FREERTOS_UNICORE=y
CONFIG_FREERTOS_TICKLESS_IDLE=y
CONFIG_FREERTOS_IDLE_TASK_STACKSIZE=1024
CONFIG_FREERTOS_TIMER_TASK_PRIORITY=1
CONFIG_FREERTOS_TIMER_TASK_STACKSIZE=2048

# ============================================================================
# Hardware Configuration (ESP32-C5)
# ============================================================================

CONFIG_IDF_TARGET_ESP32C5=y
CONFIG_ESP32C5_DEFAULT_CPU_CLOCK_240=y
CONFIG_ESP32C5_WIFI_CLOCK_APB=y
CONFIG_ESP32C5_WIFI_CLOCK_XTAL=y

# ============================================================================
# Debug Configuration
# ============================================================================

CONFIG_LOG_DEFAULT_LEVEL_INFO=y
CONFIG_LOG_BOOTLOADER_LEVEL_INFO=y
CONFIG_ESP32C5_LOG_UART=y
CONFIG_ESP32C5_LOG_UART_BAUDRATE=115200

# ============================================================================
# Component Configuration
# ============================================================================

CONFIG_DRIVER_UART=y
CONFIG_DRIVER_LEDC=y
CONFIG_DRIVER_ADC=y
CONFIG_DRIVER_GPIO=y
CONFIG_DRIVER_I2C=y
CONFIG_DRIVER_SPI_MASTER=y

# ============================================================================
# Security Configuration
# ============================================================================

CONFIG_MBEDTLS=y
CONFIG_MBEDTLS_TLS_SERVER=y
CONFIG_MBEDTLS_TLS_CLIENT=y
CONFIG_MBEDTLS_SSL_PROTOCOLS=y

# ============================================================================
# Partition Table
# ============================================================================

CONFIG_PARTITION_TABLE_SINGLE_APP=y
CONFIG_PARTITION_TABLE_CUSTOM=y
CONFIG_PARTITION_TABLE_CUSTOM_FILENAME="partitions.csv"

# ============================================================================
# Bootloader Configuration
# ============================================================================

CONFIG_BOOTLOADER_LOG_LEVEL_INFO=y
CONFIG_BOOTLOADER_COMPRESS=y
CONFIG_BOOTLOADER_VERIFY_SIGNATURE=y

# ============================================================================
# Application Configuration
# ============================================================================

CONFIG_APP_BUILD_TYPE=release
CONFIG_APP_COMPILE_TIME=y
CONFIG_APP_EXTRA_CFLAGS=""
CONFIG_APP_EXTRA_CXXFLAGS=""
CONFIG_APP_EXTRA_LDFLAGS=""
```
